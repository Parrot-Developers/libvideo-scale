## config.in
```kconfig
    config VSCALE_LIBYUV
        bool "vscale libyuv implementation"
            default false
        help
            Enable the libyuv implementation in libvideo-scale.

    config VSCALE_HISI
        bool "vscale HiSilicon implementation"
            default false
        help
            Enable the HiSilicon implementation in libvideo-scale.

    config VSCALE_QCOM
        bool "vscale Qualcomm implementation"
            default false
        help
            Enable the Qualcomm implementation in libvideo-scale.
```
